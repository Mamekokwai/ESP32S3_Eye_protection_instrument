## main/Kconfig.projbuild
```kconfig
menu "Eye-care production security"

    config EYECARE_PRODUCTION_LOCK
        bool "Require a signed SD-card token before first use"
        default n
        select EFUSE_CUSTOM_TABLE
        help
            Enables EYECARE_ENABLE_ENCRYPTION in main/production_unlock.h.
            On a device whose permanent unlock eFuse is not set, start only
            the SD-card unlock loop. A shared ECDSA P-256 signed token must
            be present at /eyecare.unlock (not device-bound; one card unlocks
            every device). Successful verification burns the one-way unlock
            eFuse and normal application startup continues.

    config EYECARE_UNLOCK_RETRY_MS
        int "Unlock token retry interval (ms)"
        depends on EYECARE_PRODUCTION_LOCK
        range 250 10000
        default 1000

endmenu
```

## sdkconfig.defaults
```kconfig
CONFIG_SPIRAM=y
CONFIG_SPIRAM_MODE_OCT=y
CONFIG_SPIRAM_SPEED_80M=y
CONFIG_ESP_DEFAULT_CPU_FREQ_MHZ_240=y
CONFIG_ESP_DEFAULT_CPU_FREQ_MHZ=240
CONFIG_COMPILER_OPTIMIZATION_PERF=y
# CONFIG_COMPILER_OPTIMIZATION_DEBUG is not set
CONFIG_ESPTOOLPY_FLASHSIZE_16MB=y
CONFIG_ESPTOOLPY_FLASHSIZE="16MB"
CONFIG_PARTITION_TABLE_CUSTOM=y
CONFIG_PARTITION_TABLE_CUSTOM_FILENAME="partitions.csv"
CONFIG_PARTITION_TABLE_FILENAME="partitions.csv"
CONFIG_FREERTOS_HZ=1000
CONFIG_ESP_MAIN_TASK_STACK_SIZE=8192
CONFIG_FATFS_LFN_HEAP=y
CONFIG_FATFS_MAX_LFN=255
# GBK16 中文字库: FATFS 用 CODEPAGE_936 + ANSI/OEM,
# d_name 返回 GBK 双字节, 屏幕(sdlist/gbk_show_string)与启动提示直接索引字库。
CONFIG_FATFS_CODEPAGE_936=y
CONFIG_FATFS_API_ENCODING_ANSI_OEM=y
# CONFIG_FATFS_API_ENCODING_UTF_8 is not set
# CONFIG_ESP_CONSOLE_USB_SERIAL_JTAG=y  /* TODO: USB烧录+日志, 等USB识别问题解决后启用 */
CONFIG_USJ_ENABLE_USB_SERIAL_JTAG=n      /* 关 JTAG 释放 IO39-42 给 I2S 用 */
```
